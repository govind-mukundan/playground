## yocto/meta-panl/conf/layer.conf
```bitbake
# We have a conf and classes directory, add to BBPATH
BBPATH .= ":${LAYERDIR}"

# We have recipes-* directories, add to BBFILES
BBFILES += "${LAYERDIR}/recipes-*/*/*.bb \
            ${LAYERDIR}/recipes-*/*/*.bbappend"

BBFILE_COLLECTIONS += "meta-panl"
BBFILE_PATTERN_meta-panl = "^${LAYERDIR}/"
BBFILE_PRIORITY_meta-panl = "6"
```
